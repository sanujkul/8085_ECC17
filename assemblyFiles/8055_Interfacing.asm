# PORTA EQU 00H
# PORTB EQU 08H
# PORTC EQU 04H
# CNTRL EQU 0CH


MAIN:	MVI A, 80H; ALL PORTS IN OUTPUT MODE
	OUT CNTRL;
	MVI A, 00H; EN = LOW (PC0 = EN = 0)
	OUT CNTRL;

INIT:	MVI A, 30H; PRECAUTIONARY CODE
	MOV B,A; SAVE THE CODE
	CALL OUTPUT; DB7 CANT BE CHECKED WRITE NOW
	CALL CMDOUT;
	CALL CMDOUT;
	;(Actual initialisation) SETTING CONTROL REG
	MVI A, 38H;
	CALL CMDOUT;
	MVI A, 08H; Display off
	CALL CMDOUT;
	MVI A, 01H; CODE FOR CLEAR DISPLAY
	CALL CMDOUT;
	MVI A, 07H; ENTRY MODE SET; SHIFTING ON
	CALL CMDOUT;
	MVI A, 0EH; TURN ON CURSOR, DISPLAY, BLINK
	CALL CMDOUT;

DISPLAY: 	MVI A, 87H; WRITE TO 7TH LOCATION
	CALL CMDOUT;
	MVI A, 53H;
	CALL DTAOUT;
	MVI A, 48H;
	CALL DTAOUT;
	
	HLT;

CMDOUT: 	MOV B,A; SAVE DATA BYTE
	CALL CHKDB7; CALLING CHKDB7
OUTPUT:	MVI A, 02H; Select data Reg, SETTING PC1 = RS = 0
	OUT CNTRL;
	MVI A, 04h; Enable Write, PC2 = R/W = 0;
	OUT CNTRL;
	MVI A, 01H; Set Enable HIGH
	OUT CNTRL;
	MOV A,B;    Get the data
	OUT PORTB;
	MVI A, 00H;  Set EN LOW
	OUT CNTRL;
	RET;


DTAOUT: 	MOV B,A; SAVE DATA BYTE
	CALL CHKDB7; CALLING CHKDB7
	MVI A, 03H; Select data Reg, SETTING PC1 = RS = 1
	OUT CNTRL;
	MVI A, 04h; Enable Write, PC2 = R/W = 0;
	OUT CNTRL;
	MVI A, 01H; Set Enable HIGH
	OUT CNTRL;
	MOV A,B;    Get the data
	OUT PORTB;
	MVI A, 00H; Set EN LOW
	OUT CNTRL;
	RET;

CHKDB7:	MVI A, 92H; Set up portB as inputPort
	OUT CNTRL
	MVI A, 02H; Seting PC1 = RS = 0;
	OUT CNTRL;
	MVI A, 05H; PC2 = R/w = 1
	OUT CNTRL;
READ:	MVI A, 01H; SET ENABLE HIGH
	OUT CNTRL;
	IN PORTB;	 READ PORTB AND CHECK DB7
	RLC; 
	MVI A, 00H;  SETTING ENABLE LOW
	OUT CNTRL;	
	JC READ;	 IF DB7=1, GO BACK AND CHECK AGAIN
	MVI A, 80H; SET UP PORTB AS OUTPUT AGAIN
	OUT CNTRL
	RET;

SCROLLDELAY: LXI D,7A30; FOR 250MS delay	
SCROLLDELAYLoop:
	   DCX D
	   MOV A,D
	   ORA E
	   JNZ SCROLLDELAYLoop
	   RET
